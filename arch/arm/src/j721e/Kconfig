## arch/arm/src/j721e/Kconfig
```kconfig
#
# For a description of the syntax of this configuration file,
# see the file kconfig-language.txt in the NuttX tools repository.
#

comment "J721E Configuration Options"


#####################################################################
#  UART Configuration
#####################################################################

config J721E_UART0
	bool "UART0"
	default y
	select UART0_SERIALDRIVER
	select ARCH_HAVE_SERIAL_TERMIOS
	---help---
		Most UART parameters are configured here.  See also the
		Board Selection menu to configure the pins used by UART0

if J721E_UART0

config J721E_UART0_BAUD
	int "J721E UART0 BAUD"
	default 115200
	---help---
		J721E UART0 communication bit rate.  The range of available
		baud rates depend on the clock supplied to the UART. Given
		the normally configured 125 MHz clock, the baud
		rates between 120 and 7 812 500 baud are available.

config J721E_UART0_PARITY
	int "J721E UART0 parity"
	default 0
	range 0 2
	---help---
		J721E UART0 parity.  0=None, 1=Odd, 2=Even.  Default: None

config J721E_UART0_BITS
	int "J721E UART0 number of bits"
	default 8
	range 5 8
	---help---
		J721E UART0 number of bits.  Default: 8

config J721E_UART0_2STOP
	int "J721E UART0 two stop bits"
	default 0
	---help---
		0=1 stop bit, 1=Two stop bits.  Default: 1 stop bit

endif # J721E_UART0

#####################################################################
#  GPIO Configuration
#####################################################################

config J721E_GPIO
	bool "GPIO"
	select GPIO
	---help---
		Build in support for GPIO.

#####################################################################
#  I2C Configuration (Master)
#####################################################################

config J721E_I2C
	bool "I2C Master"
	select I2C
	---help---
		Build in support for I2C master mode.
		Note: Do not configure the same port as both master and slave.

if J721E_I2C

config J721E_I2C0
	bool "I2C0"
	default n
	---help---
		See the Board Selection menu to configure the pins used by I2C0.

config J721E_I2C1
	bool "I2C1"
	default n
	---help---
		See the Board Selection menu to configure the pins used by I2C1.

config J721E_I2C_DRIVER
	bool "I2C character driver"
	default n
	select I2C_DRIVER
	---help---
		Build in support for a character driver at /dev/i2c[N] that may be
		used to perform I2C bus transfers from applications.  The intent of
		this driver is to support I2C testing.  It is not suitable for use
		in any real driver application.

endif # J721E_I2C


#####################################################################
#  IPC Configuration
#####################################################################

menuconfig ARCH_BOARD_IPCC
	bool "Enabled IPCC"
	select IPCC
	select J721E_IPCC
	default n
	---help---
		Enables IPCC (inter processor communication controller)
		to exchange data between MPU and MCU. Channels are
		indexed from 0. IPCC will be accessible as character
		device under "/dev/ipccN" path, where N is an ipcc channel.

if ARCH_BOARD_IPCC

comment "IPCC buffering is off, enable IPCC_BUFFERED to configure buffers"
	depends on !IPCC_BUFFERED

comment "IPCC channel 1 enabled by default"

endif # ARCH_BOARD_IPCC

#####################################################################
#  McASP Configuration
#####################################################################

config J721E_MCASP
	bool "MCASP"
	select MCASP
	---help---
		The multichannel audio serial port (McASP) functions as a
		general-purpose audio serial port optimized for the needs of
		multichannel audio applications.

#####################################################################
#  Power Management (PM) Configuration
#####################################################################

config J721E_PM
	bool "PM"
	select PM
	---help---
    	The Power Management (PM) low level driver provide power and
		thermal management capabilities for RTOS applications.


#####################################################################
#  SPI Configuration
#####################################################################

config J721E_SPI
	bool "SPI Master Mode Support"
	select SPI
	---help---
		SPI driver enables communication for general SPI, MCSPI
		(Multichannel SPI), QSPI (Quad SPI) and OSPI (Octal SPI) based
		peripherals on board through common API to application

if J721E_SPI

endif # J721E_SPI


#####################################################################
#  PWM Configuration
#####################################################################

config RP2040_PWM
	bool "PWM"
	select PWM
	---help---
		After enabling PWM support here, configure the GPIO pins to use
		under the Board Selection menu.

if J721E_EPWM

config J721E_EPWM0
	bool "PWM0"
	---help---
		See the Board Selection menu to configure the pins used by EPWM0.


config J721E_EPWM1
	bool "PWM1"
	---help---
		See the Board Selection menu to configure the pins used by EPWM1.

config J721E_EPWM2
	bool "PWM2"
	---help---
		See the Board Selection menu to configure the pins used by EPWM2.

config J721E_EPWM3
	bool "PWM3"
	---help---
		See the Board Selection menu to configure the pins used by EPWM3.

config J721E_EPWM4
	bool "PWM4"
	---help---
		See the Board Selection menu to configure the pins used by EPWM4.

config J721E_EPWM5
	bool "PWM5"
	---help---
		See the Board Selection menu to configure the pins used by EPWM5.

endif # J721E_EPWM
```

## boards/arm/j721e/common/Kconfig
```kconfig
#
# For a description of the syntax of this configuration file,
# see the file kconfig-language.txt in the NuttX tools repository.
#

#####################################################################
#  Build Configuration
#####################################################################

config J721E_FLASH_BOOT
	bool "flash boot"
	default y
	---help---
		If y, the built binary can be used for flash boot.
		If not, the binary is for SRAM boot.

config J721E_FLASH_CHIP
	string "Second stage boot loader"
	default "w25q080"
	---help---
		This is the name of the Pico-SDK second stage boot loader
		to use for this board.  This board using a Q16 flash chip
		which is compatible with the w25q080 boot loader.
		Basically this option should not be changed.

config J721E_UF2_BINARY
	bool "uf2 binary format"
	default y
	---help---
		Create nuttx.uf2 binary format used on J721E based arch.

#####################################################################
#  UART Configuration
#####################################################################

if J721E_UART0

config J721E_UART0_TX_GPIO
	int "GPIO pin for UART0 TX (0, 12, 16, or 28)"
	default 0
	range 0 28
	---help---
		J721E UART0 TX pin number used for data transmitted
		from the J721E.  Refer to board documentation to see
		which pins are available.

config J721E_UART0_RX_GPIO
	int "GPIO pin for UART0 RX (1, 13, 17, or 29)"
	default 1
	range 1 29
	---help---
		J721E UART0 RX pin number used for data received by the
		J721E.  Refer to board documentation to see which pins
		are available.

if SERIAL_IFLOWCONTROL

config J721E_UART0_CTS_GPIO
	int "GPIO pin for UART0 CTS (2, 14, or 18)"
	default 2
	range 2 18
	---help---
		J721E UART0 CTS pin number an output pin that reflects the
		UARTs ability to receive data.  This pin will be asserted when
		the UART is able to receive another character.  Refer to board
		documentation to see which pins are available.

endif # SERIAL_IFLOWCONTROL

if SERIAL_OFLOWCONTROL

config J721E_UART0_RTS_GPIO
	int "GPIO pin for UART0 RTS (3, 15, or 19)"
	default 3
	range 2 19
	---help---
		J721E UART0 RTS pin number an input pin used to control
		transmission by the UART.  If output flow control is
		enabled this pin must be asserted before data will be
		transmitted.  Refer to board documentation to see which
		pins are available.

endif # SERIAL_OFLOWCONTROL

endif # J721E_UART0

#####################################################################

if J721E_UART1

config J721E_UART1_TX_GPIO
	int "GPIO pin for UART1 TX (4, 8, 20, or 24)"
	default 20
	range 4 24
	---help---
		J721E UART1 TX pin number.  Refer to board documentation
		to see which pins are available.

config J721E_UART1_RX_GPIO
	int "GPIO pin for UART1 RX (5, 9, 21, or 25)"
	default 21
	range 5 25
	---help---
		J721E UART1 RX pin number.  Refer to board documentation
		to see which pins are available.

if SERIAL_IFLOWCONTROL

config J721E_UART1_CTS_GPIO
	int "GPIO pin for UART1 CTS (6, 10, 22, or 26)"
	default 22
	range 6 26
	---help---
		J721E UART1 CTS pin number an output pin that reflects the
		UARTs ability to receive data.  This pin will be asserted when
		the UART is able to receive another character.  Refer to board
		documentation to see which pins are available.

endif # SERIAL_IFLOWCONTROL

if SERIAL_OFLOWCONTROL

config J721E_UART1_RTS_GPIO
	int "GPIO pin for UART1 RTS (7, 11, 23, or 27)"
	default 23
	range 7 27
	---help---
		J721E UART01 RTS pin number an input pin used to control
		transmission by the UART.  If output flow control is
		enabled this pin must be asserted before data will be
		transmitted.  Refer to board documentation to see which
		pins are available.

endif # SERIAL_OFLOWCONTROL

endif # J721E_UART1

#####################################################################
#  SPI Configuration
#####################################################################

if J721E_SPI0

config J721E_SPI0_RX_GPIO
	int "GPIO pin for SPI0 RX (0, 4, 16, or 20)"
	default 16
	range 0 20
	---help---
		Refer to board documentation to see which pins are available.
		This line is also known as MISO when we are configured in
		SPI master mode.

config J721E_SPI0_CS_GPIO
	int "GPIO pin for SPI0 CSn (1, 5, 17, or 21)"
	default 17
	range 1 21
	---help---
		Refer to board documentation to see which pins are available.


config J721E_SPI0_SCK_GPIO
	int "GPIO pin for SPI0 SCK (2, 6, 18, or 22)"
	default 18
	range 2 22
	---help---
		Refer to board documentation to see which pins are available.

config J721E_SPI0_TX_GPIO
	int "GPIO pin for SPI0 TX (3, 7, 19, or 23)"
	default 19
	range 3 23
	---help---
		Refer to board documentation to see which pins are available.
		This line is also known as MOSI when we are configured in
		SPI master mode.

endif # J721E_SPI0

#####################################################################

if J721E_SPI1

config J721E_SPI1_RX_GPIO
	int "GPIO pin for SPI1 RX (8, 12, 24, or 28)"
	default 8
	range 8 28
	---help---
		Refer to board documentation to see which pins are available.
		This line is also known as MISO when we are configured in
		SPI master mode, or MOSI when slave mode is configured.

config J721E_SPI1_CS_GPIO
	int "GPIO pin for SPI1 CSn (9, 13, 25, or 29)"
	default 9
	range 9 29
	---help---
		Refer to board documentation to see which pins are available.

config J721E_SPI1_SCK_GPIO
	int "GPIO pin for SPI1 SCK (10, 14, or 26)"
	default 10
	range 10 26
	---help---
		Refer to board documentation to see which pins are available.

config J721E_SPI1_TX_GPIO
	int "GPIO pin for SPI1 TX (11, 15, or 27)"
	default 11
	range 11 27
	---help---
		Refer to board documentation to see which pins are available.
		This line is also known as MOSI when we are configured in
		SPI master mode, or MISO when slave mode is configured.

endif # J721E_SPI1

#####################################################################
#  I2C Configuration
#####################################################################

if J721E_I2C0 || J721E_I2C0_SLAVE

config J721E_I2C0_SDA_GPIO
	int "GPIO pin for I2C0 SDA (0, 4, 8, 12, 16, 20, 24, or 28)"
	default 4
	range 0 28
	---help---
		Refer to board documentation to see which pins are available.

config J721E_I2C0_SCL_GPIO
	int "GPIO pin for I2C0 SCL (1, 5, 9, 13, 17, 21, 25, or 29)"
	default 5
	range 1 29
	---help---
		Refer to board documentation to see which pins are available.

endif # J721E_I2C0 || J721E_I2C0_SLAVE

#####################################################################

if J721E_I2C1 || J721E_I2C1_SLAVE

config J721E_I2C1_SDA_GPIO
	int "GPIO pin for I2C1 SDA (2, 6, 10, 14, 18, 22, or 26)"
	default 6
	range 2 26
	---help---
		Refer to board documentation to see which pins are available.

config J721E_I2C1_SCL_GPIO
	int "GPIO pin for I2C1 SCL (3, 7, 11, 15, 19, 23, or 27)"
	default 7
	range 3 27
	---help---
		Refer to board documentation to see which pins are available.

endif # J721E_I2C1 || J721E_I2C1_SLAVE

#####################################################################
#  PWM Configuration
#####################################################################

if J721E_PWM0

config J721E_PWM0A_GPIO
	int "GPIO pin for PWM0 channel 1 (0, 16 or -1:no assign)"
	default 0
	range -1 16
	---help---
		This sets the GPIO pin to use for the A channel it must be
		either 0 or 16, any other value disables the output.
		Refer to board documentation to see which pins are available.

endif # J721E_PWM0

#####################################################################

if J721E_PWM1

config J721E_PWM1A_GPIO
	int "GPIO pin for PWM1 channel 1 (2, 18 or -1:no assign)"
	default 2
	range -1 29
	---help---
		This sets the GPIO pin to use for the A channel it must be
		either 2 or 18, any other value disables the output.
		Refer to board documentation to see which pins are available.

endif # J721E_PWM1

#####################################################################

if J721E_PWM2

config J721E_PWM2A_GPIO
	int "GPIO pin for PWM2 channel 1 (4, 20 or -1:no assign)"
	default 4
	range -1 29
	---help---
		This sets the GPIO pin to use for the A channel it must be
		either 4 or 20, any other value disables the output.
		Refer to board documentation to see which pins are available.

endif # J721E_PWM2

#####################################################################

if J721E_PWM3

config J721E_PWM3A_GPIO
	int "GPIO pin for PWM3 channel 1 (6, 22 or -1:no assign)"
	default 6
	range -1 29
	---help---
		This sets the GPIO pin to use for the A channel it must be
		either 6 or 22, any other value disables the output.
		Refer to board documentation to see which pins are available.

endif # J721E_PWM3

#####################################################################

if J721E_PWM4

config J721E_PWM4A_GPIO
	int "GPIO pin for PWM4 channel 1 (8, 24 or -1:no assign)"
	default 8
	range -1 29
	---help---
		This sets the GPIO pin to use for the A channel it must be
		either 8 or 24, any other value disables the output.
		Refer to board documentation to see which pins are available.

endif # J721E_PWM4

#####################################################################

if J721E_PWM5

config J721E_PWM5A_GPIO
	int "GPIO pin for PWM5 channel 1 (10, 26 or -1:no assign)"
	default 10
	range -1 29
	---help---
		This sets the GPIO pin to use for the A channel it must be
		either 10 or 26, any other value disables the output.
		Refer to board documentation to see which pins are available.

endif # J721E_PWM5

#####################################################################
```
